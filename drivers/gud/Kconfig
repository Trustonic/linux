## drivers/gud/Kconfig
```kconfig
#
# MobiCore configuration
#
config TRUSTONIC_TRUSTED_UI
    tristate "<t-base TUI"
    default y
    ---help---
      Enable <t-base Trusted User Interface

config TRUSTONIC_TRUSTED_UI_FB_BLANK
    bool "<t-base TUI with fb_blank"
    depends on TRUSTONIC_TRUSTED_UI
    default y
    ---help---
    Blank the framebuffer before starting a TUI session
```

## drivers/usb/dwc3/Kconfig
```kconfig
config USB_DWC3
	tristate "DesignWare USB3 DRD Core Support"
	depends on (USB && USB_GADGET)
	select USB_OTG_UTILS
	select USB_GADGET_DUALSPEED
	select USB_GADGET_SUPERSPEED
	select USB_XHCI_PLATFORM
	help
	  Say Y or M here if your system has a Dual Role SuperSpeed
	  USB controller based on the DesignWare USB3 IP Core.

	  If you choose to build this driver is a dynamically linked
	  module, the module will be called dwc3.ko.

config USB_EXYNOS_DRD
	bool "Exynos SuperSpeed USB3.0 DRD core"
	depends on EXYNOS5_DEV_USB3_DRD
	select USB_OTG_UTILS
	help
	  Say Y here if your system has an Exynos SuperSpeed USB3.0
	  Dual Role Device controller based on DesignWare USB3 IP
	  Core.

if (USB_DWC3 || USB_EXYNOS_DRD)

config USB_DWC3_DEBUG
	bool "Enable DWC3/Exynos DRD core Debugging Messages"
	help
	  Say Y here to enable debugging messages on DWC3/Exynos DRD Driver.

config USB_DWC3_VERBOSE
	bool "Enable DWC3/Exynos DRD core Verbose Debugging Messages"
	depends on USB_DWC3_DEBUG
	help
	  Say Y here to enable verbose debugging messages on DWC3/Exynos DRD
	  Driver.

endif
```
